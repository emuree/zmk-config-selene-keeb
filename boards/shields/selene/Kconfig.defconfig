## boards/shields/selene/Kconfig.defconfig
```kconfig
if SHIELD_SELENE_LEFT

config ZMK_KEYBOARD_NAME
    default "Selene"

config ZMK_SPLIT_ROLE_CENTRAL
    default y

endif

if SHIELD_SELENE_LEFT || SHIELD_SELENE_RIGHT

config ZMK_SPLIT
    default y

endif
```

## boards/shields/selene/Kconfig.shield
```kconfig
config SHIELD_SELENE_LEFT
    def_bool $(shields_list_contains,selene_left)

config SHIELD_SELENE_RIGHT
    def_bool $(shields_list_contains,selene_right)
```

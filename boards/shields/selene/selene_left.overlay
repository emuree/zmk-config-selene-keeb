#include "selene.dtsi"

&kscan0 {
    // Rows starting from the top row
    row-gpios
        = <&pro_micro 14 (GPIO_ACTIVE_HIGH | GPIO_PULL_DOWN)>  // row_number
        , <&pro_micro 15 (GPIO_ACTIVE_HIGH | GPIO_PULL_DOWN)>  // row_top
        , <&pro_micro 18 (GPIO_ACTIVE_HIGH | GPIO_PULL_DOWN)>  // row_home
        , <&pro_micro 3 (GPIO_ACTIVE_HIGH | GPIO_PULL_DOWN)>   // row_bottom
        , <&pro_micro 10 (GPIO_ACTIVE_HIGH | GPIO_PULL_DOWN)>  // row_thumb
        ;

    // Columns starting from the leftmost column 
    col-gpios
        = <&pro_micro 8 GPIO_ACTIVE_HIGH>  // col_extra
        , <&pro_micro 7 GPIO_ACTIVE_HIGH>  // col_pinky
        , <&pro_micro 6 GPIO_ACTIVE_HIGH>  // col_ring
        , <&pro_micro 5 GPIO_ACTIVE_HIGH>  // col_middle
        , <&pro_micro 4 GPIO_ACTIVE_HIGH>  // col_index
        , <&pro_micro 9 GPIO_ACTIVE_HIGH>  // col_inner
        , <&pro_micro 16 GPIO_ACTIVE_HIGH> // col_extra2
        ;
};